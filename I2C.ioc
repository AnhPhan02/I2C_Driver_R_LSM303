# file: I2C.ioc
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Mcu.Family=STM32F4
Mcu.Name=STM32F411V(C-E)Tx
Mcu.Package=LQFP100
NVIC.PriorityGroup=NVIC_PRIORITYGROUP_4
PA13.Mode=Serial_Wire
PA13.Signal=SYS_JTMS-SWDIO
PA14.Mode=Serial_Wire
PA14.Signal=SYS_JTCK-SWCLK
ProjectManager.HeapSize=0x200
ProjectManager.StackSize=0x400
ProjectManager.TargetToolchain=STM32CubeIDE
RCC.AHBFreq_Value=16000000
RCC.APB1Freq_Value=16000000
RCC.APB2Freq_Value=16000000
RCC.CortexFreq_Value=16000000
RCC.HSE_VALUE=25000000
RCC.HSI_VALUE=16000000
RCC.LSE_VALUE=32768
RCC.SYSCLKFreq_VALUE=16000000
RCC.VCOOutputFreq_Value=192000000
board=custom

// file: Core/Src/main.c
/* USER CODE BEGIN Header */
/**
  ******************************************************************************
  * @file           : main.c
  * @brief          : Main program body
  ******************************************************************************
  * @attention
  *
  * Copyright (c) 2024 STMicroelectronics.
  * All rights reserved.
  *
  * This software is licensed under terms that can be found in the LICENSE file
  * in the root directory of this software component.
  * If no LICENSE file comes with this software, it is provided AS-IS.
  *
  ******************************************************************************
  */
/* USER CODE END Header */
#include "main.h"
#include "I2C.h"

/* USER CODE BEGIN PM */
#define CFG_REG_A_M	(0x60)
#define CFG_REG_B_M	(0x61)
#define CFG_REG_C_M	(0x62)

#define OUTX_L_REG_M	(0x68)
#define OUTX_H_REG_M	(0x69)
#define OUTY_L_REG_M	(0x6A)
#define OUTY_H_REG_M	(0x6B)
#define OUTZ_L_REG_M	(0x6C)
#define OUTZ_H_REG_M	(0x6D)

volatile uint16_t x_axis = 0;
volatile uint16_t y_axis = 0;
volatile uint16_t z_axis = 0;

volatile uint8_t x_l = 0, x_h = 0;
volatile uint8_t y_l = 0, y_h = 0;
volatile uint8_t z_l = 0, z_h = 0;
/* USER CODE END PM */

void SystemClock_Config(void);
static void MX_GPIO_Init(void);

int main(void)
{

  /* MCU Configuration--------------------------------------------------------*/

  /* Reset of all peripherals, Initializes the Flash interface and the Systick. */
  HAL_Init();

  /* Configure the system clock */
  SystemClock_Config();

  /* Initialize all configured peripherals */
  MX_GPIO_Init();
  /* USER CODE BEGIN 2 */
  I2C_Init();
  const uint8_t accel_addr = 0b0011001;
  const uint8_t magnetic_addr = 0b0011110;
  uint8_t accel = I2C_Read(accel_addr, 0x0F);
  uint8_t magne = I2C_Read(magnetic_addr, 0x4F);
  uint8_t reg_val = I2C_Read(accel_addr, 0x20);

  I2C_Write(accel_addr, 0x20, 0b1111);
  reg_val = I2C_Read(accel_addr, 0x20);

  I2C_Write(magnetic_addr, CFG_REG_A_M, 0x0C);
  I2C_Write(magnetic_addr, CFG_REG_B_M, 0x02);
  I2C_Write(magnetic_addr, CFG_REG_C_M, 0x10);
  /* USER CODE END 2 */

  /* Infinite loop */
  while (1)
  {
	  x_l = I2C_Read(magnetic_addr, OUTX_L_REG_M);
	  x_h = I2C_Read(magnetic_addr, OUTX_H_REG_M);

	  y_l = I2C_Read(magnetic_addr, OUTY_L_REG_M);
	  y_h = I2C_Read(magnetic_addr, OUTY_H_REG_M);

	  z_l = I2C_Read(magnetic_addr, OUTZ_L_REG_M);
	  z_h = I2C_Read(magnetic_addr, OUTZ_H_REG_M);

	  x_axis = (x_h << 8) | x_l;
	  y_axis = (y_h << 8) | y_l;
	  z_axis = (z_h << 8) | z_l;
	  HAL_Delay(1000);
    /* USER CODE BEGIN 3 */
  }
  return 0;
  /* USER CODE END 3 */
}

void SystemClock_Config(void)
{
  RCC_OscInitTypeDef RCC_OscInitStruct = {0};
  RCC_ClkInitTypeDef RCC_ClkInitStruct = {0};

  /** Configure the main internal regulator output voltage
  */
  __HAL_RCC_PWR_CLK_ENABLE();
  __HAL_PWR_VOLTAGESCALING_CONFIG(PWR_REGULATOR_VOLTAGE_SCALE1);

  /** Initializes the RCC Oscillators according to the specified parameters
  * in the RCC_OscInitTypeDef structure.
  */
  RCC_OscInitStruct.OscillatorType = RCC_OSCILLATORTYPE_HSI;
  RCC_OscInitStruct.HSIState = RCC_HSI_ON;
  RCC_OscInitStruct.HSICalibrationValue = RCC_HSICALIBRATION_DEFAULT;
  RCC_OscInitStruct.PLL.PLLState = RCC_PLL_NONE;
  if (HAL_RCC_OscConfig(&RCC_OscInitStruct) != HAL_OK)
  {
    Error_Handler();
  }

  /** Initializes the CPU, AHB and APB buses clocks
  */
  RCC_ClkInitStruct.ClockType = RCC_CLOCKTYPE_HCLK|RCC_CLOCKTYPE_SYSCLK
                              |RCC_CLOCKTYPE_PCLK1|RCC_CLOCKTYPE_PCLK2;
  RCC_ClkInitStruct.SYSCLKSource = RCC_SYSCLKSOURCE_HSI;
  RCC_ClkInitStruct.AHBCLKDivider = RCC_SYSCLK_DIV1;
  RCC_ClkInitStruct.APB1CLKDivider = RCC_HCLK_DIV1;
  RCC_ClkInitStruct.APB2CLKDivider = RCC_HCLK_DIV1;

  if (HAL_RCC_ClockConfig(&RCC_ClkInitStruct, FLASH_LATENCY_0) != HAL_OK)
  {
    Error_Handler();
  }
}

static void MX_GPIO_Init(void)
{

  /* GPIO Ports Clock Enable */
  __HAL_RCC_GPIOA_CLK_ENABLE();

}

void Error_Handler(void)
{
  __disable_irq();
  while (1)
  {
  }
}
